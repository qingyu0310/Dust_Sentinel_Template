## topic/Kconfig
```kconfig
# topic/Kconfig - inter-thread data channels

config TPC_TO_CAN_TX
    default n
    bool "CAN TX queue"
    help
        CAN transmit message queue.

config TPC_REMOTE_TO
    default n
    bool "Remote channel"
    select ZBUS
    help
        Remote data zbus channel.

config TPC_IMU_TO
    default n
    bool "IMU channel"
    select ZBUS
    help
        IMU data zbus channel.
```
